## components/mybot_platform/Kconfig.display
```kconfig
# SPDX-License-Identifier: Apache-2.0
config MYBOT_LVGL_UI
    bool
    default y
    help
        The Mosaico firmware uses the shared LVGL workflow.
```

## components/mybot_platform/boards/esp-mosaico-v1.2/sdkconfig.defaults
```kconfig
# SPDX-License-Identifier: Apache-2.0
CONFIG_PARTITION_TABLE_CUSTOM=y
CONFIG_PARTITION_TABLE_CUSTOM_FILENAME="partitions/v2/16m.csv"
CONFIG_ESPTOOLPY_FLASHSIZE_16MB=y
CONFIG_ESPTOOLPY_FLASHMODE_QIO=y
CONFIG_ESP_CONSOLE_UART_DEFAULT=y
CONFIG_ESP_CONSOLE_UART_NUM=0
CONFIG_ESP_CONSOLE_UART_TX_GPIO=58
CONFIG_ESP_CONSOLE_UART_RX_GPIO=59
CONFIG_CODEC_ES8311_SUPPORT=y
CONFIG_MYBOT_LOCAL_AEC=y
# CONFIG_MYBOT_CLOUD_AEC is not set
CONFIG_CODEC_ES8389_SUPPORT=n
CONFIG_CODEC_I2C_BACKWARD_COMPATIBLE=n
CONFIG_CODEC_ES7210_SUPPORT=n
CONFIG_CODEC_ES7243_SUPPORT=n
CONFIG_CODEC_ES7243E_SUPPORT=n
CONFIG_CODEC_ES8156_SUPPORT=n
CONFIG_CODEC_AW88298_SUPPORT=n
CONFIG_CODEC_ES8374_SUPPORT=n
CONFIG_CODEC_ES8388_SUPPORT=n
CONFIG_CODEC_TAS5805M_SUPPORT=n
CONFIG_CODEC_ZL38063_SUPPORT=n
CONFIG_CODEC_CJC8910_SUPPORT=n
CONFIG_CODEC_DUMMY_SUPPORT=n
CONFIG_CODEC_DATA_ADC_SUPPORT=n
CONFIG_MYBOT_AUDIO_PTIME_60=y
CONFIG_TINYUSB_CDC_ENABLED=y
CONFIG_TINYUSB_CDC_TX_BUFSIZE=4096
CONFIG_USB_DEVICE_UAC_AS_PART=y
CONFIG_TINYUSB_SUSPEND_CALLBACK=y
CONFIG_TINYUSB_RESUME_CALLBACK=y
# CONFIG_TINYUSB_MODE_DMA is not set
CONFIG_TINYUSB_MODE_SLAVE=y
CONFIG_UAC_SPEAKER_CHANNEL_NUM=2
CONFIG_UAC_MIC_CHANNEL_NUM=2
CONFIG_UAC_SAMPLE_RATE=48000
CONFIG_UAC_BIT_RESOLUTION_16=y
CONFIG_UAC_SPK_INTERVAL_MS=10
CONFIG_UAC_MIC_INTERVAL_MS=10
CONFIG_UAC_SUPPORT_MACOS=y
```

## components/mybot_platform/boards/esp32-s31-korvo-1/sdkconfig.defaults
```kconfig
# SPDX-License-Identifier: Apache-2.0
CONFIG_PARTITION_TABLE_CUSTOM=y
CONFIG_PARTITION_TABLE_CUSTOM_FILENAME="partitions/v2/16m.csv"
CONFIG_ESPTOOLPY_FLASHSIZE_16MB=y
CONFIG_ESPTOOLPY_FLASHMODE_QIO=y
CONFIG_ESP_CONSOLE_UART_DEFAULT=y
CONFIG_ESP_CONSOLE_UART_NUM=0
CONFIG_ESP_CONSOLE_UART_TX_GPIO=58
CONFIG_ESP_CONSOLE_UART_RX_GPIO=59
CONFIG_CODEC_ES8389_SUPPORT=y
CONFIG_CODEC_I2C_BACKWARD_COMPATIBLE=n
CONFIG_MYBOT_ENABLE_VIDEO=n
CONFIG_MYBOT_AUDIO_PTIME_60=y
```

## diagnostics/mosaico_uac/sdkconfig.defaults
```kconfig
# SPDX-License-Identifier: Apache-2.0
# Standalone V1.2 diagnostic: no business stack, storage writes, display or network.
CONFIG_IDF_TARGET="esp32s31"
CONFIG_IDF_EXPERIMENTAL_FEATURES=y
CONFIG_COMPILER_OPTIMIZATION_SIZE=y
CONFIG_FREERTOS_HZ=1000
CONFIG_ESP_MAIN_TASK_STACK_SIZE=4096
CONFIG_ESPTOOLPY_FLASHSIZE_16MB=y
CONFIG_ESPTOOLPY_FLASHMODE_DIO=y
CONFIG_ESPTOOLPY_FLASHFREQ_80M=y
CONFIG_PARTITION_TABLE_CUSTOM=y
CONFIG_PARTITION_TABLE_CUSTOM_FILENAME="diagnostics/mosaico_uac/partitions.csv"
CONFIG_PARTITION_TABLE_OFFSET=0x8000
# CONFIG_SPIRAM is not set
CONFIG_ESP_CONSOLE_UART_DEFAULT=y
CONFIG_ESP_CONSOLE_UART_NUM=0
CONFIG_ESP_CONSOLE_UART_TX_GPIO=58
CONFIG_ESP_CONSOLE_UART_RX_GPIO=59
CONFIG_CODEC_ES8311_SUPPORT=y
# CONFIG_CODEC_ES8389_SUPPORT is not set
# CONFIG_CODEC_I2C_BACKWARD_COMPATIBLE is not set
# CONFIG_USB_DEVICE_UAC_AS_PART is not set
CONFIG_TINYUSB_RHPORT_HS=y
CONFIG_UAC_TUSB_PRODUCT="Mosaico UAC Test"
CONFIG_UAC_TUSB_MANUFACTURER="MyBot"
CONFIG_UAC_TUSB_SERIAL_NUM="MOSAICO-V12-UAC-TEST"
CONFIG_UAC_SPEAKER_CHANNEL_NUM=2
CONFIG_UAC_MIC_CHANNEL_NUM=2
CONFIG_UAC_SAMPLE_RATE=48000
CONFIG_UAC_BIT_RESOLUTION_16=y
CONFIG_UAC_SPK_INTERVAL_MS=10
CONFIG_UAC_MIC_INTERVAL_MS=10
CONFIG_UAC_SPK_NEW_PLAY_INTERVAL=100
CONFIG_UAC_SPK_TASK_PRIORITY=6
CONFIG_UAC_SPK_TASK_CORE=0
CONFIG_UAC_MIC_TASK_PRIORITY=6
CONFIG_UAC_SUPPORT_MACOS=y
```

## main/Kconfig.projbuild
```kconfig
menu "mybot"

    config MYBOT_PSRAM_ALLOCATIONS
        bool
        default y
        depends on SPIRAM && (SPIRAM_USE_CAPS_ALLOC || SPIRAM_USE_MALLOC)
        select FREERTOS_TASK_CREATE_ALLOW_EXT_MEM
        select NVS_ALLOCATE_CACHE_IN_SPIRAM
        help
            Platform data and worker stacks use PSRAM. Keep kernel objects,
            hardware DMA buffers and flash-writing task stacks in internal RAM.

    choice MYBOT_LANGUAGE
        prompt "Product language"
        default MYBOT_LANGUAGE_ZH_CN

        config MYBOT_LANGUAGE_ZH_CN
            bool "Chinese (zh-CN)"

        config MYBOT_LANGUAGE_EN_US
            bool "English (en-US)"
    endchoice

    config MYBOT_LANGUAGE_TAG
        string
        default "en-US" if MYBOT_LANGUAGE_EN_US
        default "zh-CN"

    config MYBOT_SERVER_BASE
        string
        default "https://mybot.sh3t.agoralab.co/api"

    config MYBOT_SOURCE_LANGUAGE
        string "Initial source language"
        default "zh-CN"

    config MYBOT_TARGET_LANGUAGE
        string "Initial translated-output language"
        default "en-US"

    choice MYBOT_AUDIO_PTIME
        prompt "Audio packet duration"
        default MYBOT_AUDIO_PTIME_60

        help
            The bundled ESP32-S31 Agora RTSA package uses 60 ms audio frames.
            Other packet durations require a deliberately supplied matching package.

        config MYBOT_AUDIO_PTIME_60
            bool "60 ms"
    endchoice

    config MYBOT_AUDIO_PTIME_MS
        int
        default 60 if MYBOT_AUDIO_PTIME_60

    choice MYBOT_AEC_MODE
        prompt "Echo cancellation"
        default MYBOT_LOCAL_AEC

        config MYBOT_LOCAL_AEC
            bool "Local software AEC (ESP-SR)"
            help
                Capture the ES8311 microphone and synchronized DAC reference,
                run ESP-SR full-duplex AEC in the platform audio adapter, and
                upload the cleaned mono microphone signal. Cloud AEC remains
                available as an alternative but is not combined with local AEC.

        config MYBOT_CLOUD_AEC
            bool "Cloud AEC"
            help
                Upload the existing interleaved microphone/playback-reference
                format for server-side echo cancellation.

        config MYBOT_AEC_DISABLED
            bool "Disable AEC"
            help
                Diagnostic mode. Upload raw microphone PCM without local or
                cloud echo cancellation.
    endchoice

    config MYBOT_AI_QOS
        bool "Enable Agora AI QoS"
        default n

    config MYBOT_FAST_SEND_MULTIPLIER
        int "Agora fast-send multiplier"
        range 1 5
        default 3

    config MYBOT_DEBUG_RESOURCE_MONITOR
        bool "Enable debug CPU and memory monitor"
        default n
        depends on !FREERTOS_SMP
        select FREERTOS_GENERATE_RUN_TIME_STATS
        help
            Log per-core busy time estimated from idle runtime deltas and heap
            statistics using a low-priority task. Adds scheduler accounting and
            serial logging overhead; intended for diagnostics only.

    config MYBOT_DEBUG_RESOURCE_MONITOR_INTERVAL_MS
        int "Resource monitor interval (ms)"
        depends on MYBOT_DEBUG_RESOURCE_MONITOR
        range 1000 60000
        default 5000

endmenu
```

## sdkconfig.defaults.esp32s31
```kconfig
# SPDX-License-Identifier: Apache-2.0
CONFIG_ESP_DEFAULT_CPU_FREQ_MHZ_320=y
CONFIG_SPIRAM=y
CONFIG_SPIRAM_MODE_OCT=y
CONFIG_SPIRAM_SPEED_200M=y
CONFIG_SPIRAM_USE_MALLOC=y
CONFIG_SPIRAM_MALLOC_ALWAYSINTERNAL=2048
CONFIG_SPIRAM_MALLOC_RESERVE_INTERNAL=65536
CONFIG_SPIRAM_MEMTEST=y
CONFIG_FREERTOS_TASK_CREATE_ALLOW_EXT_MEM=y
CONFIG_MBEDTLS_EXTERNAL_MEM_ALLOC=y
CONFIG_ESP_SYSTEM_EVENT_TASK_STACK_SIZE=4096
```
